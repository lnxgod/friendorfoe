## esp32/ble-scanner/main/Kconfig.projbuild
```kconfig
menu "FoF BLE Scanner OLED"
    config FOF_OLED_SDA_PIN
        int "I2C SDA pin"
        default 6 if IDF_TARGET_ESP32C5
        default 21 if IDF_TARGET_ESP32
        default 4
    config FOF_OLED_SCL_PIN
        int "I2C SCL pin"
        default 7 if IDF_TARGET_ESP32C5
        default 22 if IDF_TARGET_ESP32
        default 5
    config FOF_OLED_RST_PIN
        int "OLED reset pin (-1 to disable)"
        default -1
endmenu

menu "FoF Scan Mode"
    choice FOF_SCAN_MODE
        prompt "Scanning mode"
        default FOF_SCAN_HYBRID
        config FOF_SCAN_BLE_ONLY
            bool "BLE only (max BLE sensitivity)"
        config FOF_SCAN_WIFI_ONLY
            bool "WiFi only (hidden camera SSIDs)"
        config FOF_SCAN_HYBRID
            bool "Hybrid BLE+WiFi (time-sliced)"
    endchoice
endmenu

menu "FoF Privacy Detection"
    config FOF_GLASSES_DETECTION
        bool "Enable smart glasses / privacy device detection"
        default y
        help
            Detect BLE advertisements from smart glasses (Meta Ray-Ban,
            Snap Spectacles, Xreal, Vuzix, etc.) and other privacy-intrusion
            devices (body cameras). Shows alerts on OLED and outputs via
            serial JSON. Can also be toggled at runtime via NVS.

    config FOF_GLASSES_ALERT_RSSI
        int "Minimum RSSI to alert (dBm)"
        default -75
        depends on FOF_GLASSES_DETECTION
        help
            Only alert on glasses detected above this signal strength.
            -50 dBm = very close (~2m), -70 = nearby (~10m), -90 = far.
endmenu
```

## esp32/rid-simulator/main/Kconfig.projbuild
```kconfig
menu "FoF RID Simulator OLED"
    config FOF_OLED_SDA_PIN
        int "I2C SDA pin"
        default 6 if IDF_TARGET_ESP32C5
        default 4
    config FOF_OLED_SCL_PIN
        int "I2C SCL pin"
        default 7 if IDF_TARGET_ESP32C5
        default 5
    config FOF_OLED_RST_PIN
        int "OLED reset pin (-1 to disable)"
        default -1
endmenu

menu "FoF RID Simulator Flight"
    config FOF_SIM_HOME_LAT
        string "Home latitude (decimal degrees)"
        default "0.0"
        help
            Latitude of the simulated drone orbit center.
            Set to your local test coordinates at build time.
    config FOF_SIM_HOME_LON
        string "Home longitude (decimal degrees)"
        default "0.0"
        help
            Longitude of the simulated drone orbit center.
            Set to your local test coordinates at build time.
endmenu
```

## esp32/rid-simulator/sdkconfig.defaults
```kconfig
# Friend or Foe — RID Simulator (ESP32-S3) SDK Configuration
# BLE broadcaster — transmits OpenDroneID advertisements

# ── Bluetooth / NimBLE ───────────────────────────────────────────────────────
CONFIG_BT_ENABLED=y
CONFIG_BT_NIMBLE_ENABLED=y
CONFIG_BT_NIMBLE_MAX_CONNECTIONS=0
CONFIG_BT_NIMBLE_ROLE_CENTRAL=n
CONFIG_BT_NIMBLE_ROLE_PERIPHERAL=n
CONFIG_BT_NIMBLE_ROLE_BROADCASTER=y
CONFIG_BT_NIMBLE_ROLE_OBSERVER=n

# ── WiFi (disabled) ─────────────────────────────────────────────────────────
CONFIG_ESP_WIFI_ENABLED=n

# ── Coexistence (disabled — BLE only) ───────────────────────────────────────
CONFIG_SW_COEXIST_ENABLE=n
CONFIG_ESP_COEX_SW_COEXIST_ENABLE=n

# ── PSRAM (ESP32-S3 has onboard PSRAM) ───────────────────────────────────────
CONFIG_ESP32S3_SPIRAM_SUPPORT=y
CONFIG_SPIRAM=y
CONFIG_SPIRAM_MODE_OCT=y
CONFIG_SPIRAM_SPEED_80M=y

# ── FreeRTOS ─────────────────────────────────────────────────────────────────
CONFIG_FREERTOS_HZ=1000
CONFIG_FREERTOS_UNICORE=n

# ── Watchdog ─────────────────────────────────────────────────────────────────
CONFIG_ESP_TASK_WDT_TIMEOUT_S=30

# ── Logging ──────────────────────────────────────────────────────────────────
CONFIG_LOG_DEFAULT_LEVEL_INFO=y
CONFIG_LOG_DEFAULT_LEVEL=3
```

## esp32/scanner/main/Kconfig.projbuild
```kconfig
menu "FoF Scanner OLED"
    config FOF_OLED_SDA_PIN
        int "I2C SDA pin"
        default 6 if IDF_TARGET_ESP32C5
        default 4
    config FOF_OLED_SCL_PIN
        int "I2C SCL pin"
        default 7 if IDF_TARGET_ESP32C5
        default 5
    config FOF_OLED_RST_PIN
        int "OLED reset pin (-1 to disable)"
        default -1
endmenu

menu "FoF Privacy Detection"
    config FOF_GLASSES_DETECTION
        bool "Enable smart glasses / privacy device detection"
        default y
        help
            Detect BLE advertisements from smart glasses (Meta Ray-Ban,
            Snap Spectacles, Xreal, Vuzix, etc.) and other privacy-intrusion
            devices (body cameras). Shows alerts on OLED and outputs via
            serial JSON. Can also be toggled at runtime via NVS.

    config FOF_GLASSES_ALERT_RSSI
        int "Minimum RSSI to alert (dBm)"
        default -75
        depends on FOF_GLASSES_DETECTION
        help
            Only alert on glasses detected above this signal strength.
            -50 dBm = very close (~2m), -70 = nearby (~10m), -90 = far.
endmenu
```

## esp32/scanner/sdkconfig.defaults
```kconfig
# Friend or Foe — Scanner (ESP32-S3) SDK Configuration
# Console config is per-variant: scanner-s3.defaults sets USB-JTAG,
# scanner-s3-legacy uses UART default (via cached sdkconfig)

# ── Bluetooth (disabled — BLE runs on separate board) ────────────────────────
CONFIG_BT_ENABLED=n

# ── WiFi ─────────────────────────────────────────────────────────────────────
CONFIG_ESP_WIFI_ENABLED=y
CONFIG_ESP_WIFI_STATIC_RX_BUFFER_NUM=16
CONFIG_ESP_WIFI_DYNAMIC_RX_BUFFER_NUM=32

# ── Coexistence (disabled — WiFi only) ──────────────────────────────────────
CONFIG_SW_COEXIST_ENABLE=n
CONFIG_ESP_COEX_SW_COEXIST_ENABLE=n

# ── PSRAM (ESP32-S3 has onboard PSRAM) ───────────────────────────────────────
CONFIG_ESP32S3_SPIRAM_SUPPORT=y
CONFIG_SPIRAM=y
CONFIG_SPIRAM_MODE_OCT=y
CONFIG_SPIRAM_SPEED_80M=y

# ── FreeRTOS ─────────────────────────────────────────────────────────────────
CONFIG_FREERTOS_HZ=1000
CONFIG_FREERTOS_UNICORE=n

# ── Watchdog ─────────────────────────────────────────────────────────────────
CONFIG_ESP_TASK_WDT_TIMEOUT_S=30

# ── Logging (keep INFO in dev, switch to WARN for release) ───────────────────
CONFIG_LOG_DEFAULT_LEVEL_INFO=y
CONFIG_LOG_DEFAULT_LEVEL=3
```

## esp32/uplink/main/Kconfig.projbuild
```kconfig
menu "FoF Uplink OLED"
    config FOF_OLED_SDA_PIN
        int "I2C SDA pin"
        default 4
    config FOF_OLED_SCL_PIN
        int "I2C SCL pin"
        default 5
    config FOF_OLED_RST_PIN
        int "OLED reset pin (-1 to disable)"
        default -1
endmenu
```

## esp32/uplink/sdkconfig.defaults
```kconfig
# Friend or Foe — Uplink (ESP32-C3) SDK Configuration
# WiFi STA + HTTP client for backend communication

# ── WiFi ─────────────────────────────────────────────────────────────────────
CONFIG_ESP_WIFI_ENABLED=y
CONFIG_ESP_WIFI_STATIC_RX_BUFFER_NUM=10
CONFIG_ESP_WIFI_DYNAMIC_RX_BUFFER_NUM=32

# ── FreeRTOS ─────────────────────────────────────────────────────────────────
CONFIG_FREERTOS_HZ=1000

# ── Watchdog ─────────────────────────────────────────────────────────────────
CONFIG_ESP_TASK_WDT_TIMEOUT_S=30

# ── Console via USB-JTAG (frees UART0 for GPS) ─────────────────────────────
CONFIG_ESP_CONSOLE_USB_SERIAL_JTAG=y

# ── SNTP for time synchronization ────────────────────────────────────────────
CONFIG_LWIP_SNTP_MAX_SERVERS=2

# ── Logging ──────────────────────────────────────────────────────────────────
CONFIG_LOG_DEFAULT_LEVEL_INFO=y
CONFIG_LOG_DEFAULT_LEVEL=3
```
